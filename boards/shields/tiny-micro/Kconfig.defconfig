## boards/shields/tiny-micro/Kconfig.defconfig
```kconfig
if SHIELD_TINY_MICRO

config ZMK_KEYBOARD_NAME
    default "tiny-micro"

endif # SHIELD_TINY_MICRO
```

## boards/shields/tiny/Kconfig.defconfig
```kconfig
if SHIELD_TINY && !SHIELD_TINY_MICRO

config ZMK_KEYBOARD_NAME
    default "tiny"

endif # SHIELD_TINY && !SHIELD_TINY_MICRO
```
